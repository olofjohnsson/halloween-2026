## CMakeLists.txt
```
cmake_minimum_required(VERSION 3.20.0)
find_package(Zephyr REQUIRED HINTS $ENV{ZEPHYR_BASE})
project(halloween_blink_tester)

target_sources(app PRIVATE src/main.c)
```

## prj.conf
```kconfig
CONFIG_GPIO=y

# Flashed over SWD without MBR/bootloader, so the vector table must be at 0x0.
CONFIG_FLASH_LOAD_OFFSET=0x0
```

## boards/promicro_nrf52840_nrf52840.overlay
```dts
/* Blink output on P0.15 (the Pro Micro's LED, assumed active high). */
/ {
    blink_leds {
        compatible = "gpio-leds";
        blink_led: blink_led {
            gpios = <&gpio0 15 GPIO_ACTIVE_HIGH>;
        };
    };
};
```

## src/main.c
```c
#include <zephyr/kernel.h>
#include <zephyr/drivers/gpio.h>

static const struct gpio_dt_spec led = GPIO_DT_SPEC_GET(DT_NODELABEL(blink_led), gpios);

int main(void)
{
    if (gpio_pin_configure_dt(&led, GPIO_OUTPUT_INACTIVE) < 0) {
        return 0;
    }

    while (1) {
        (void)gpio_pin_toggle_dt(&led);
        k_msleep(500);
    }

    return 0;
}
```
