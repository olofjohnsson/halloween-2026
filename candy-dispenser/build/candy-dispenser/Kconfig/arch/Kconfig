## candy-dispenser/build/candy-dispenser/Kconfig/arch/Kconfig
```kconfig
# Load Zephyr Arch Kconfig descriptions.
osource "/home/olof-johnsson/ncs/v3.4.0/zephyr/arch/rx/Kconfig"
osource "/home/olof-johnsson/ncs/v3.4.0/zephyr/arch/x86/Kconfig"
osource "/home/olof-johnsson/ncs/v3.4.0/zephyr/arch/xtensa/Kconfig"
osource "/home/olof-johnsson/ncs/v3.4.0/zephyr/arch/sparc/Kconfig"
osource "/home/olof-johnsson/ncs/v3.4.0/zephyr/arch/riscv/Kconfig"
osource "/home/olof-johnsson/ncs/v3.4.0/zephyr/arch/posix/Kconfig"
osource "/home/olof-johnsson/ncs/v3.4.0/zephyr/arch/openrisc/Kconfig"
osource "/home/olof-johnsson/ncs/v3.4.0/zephyr/arch/mips/Kconfig"
osource "/home/olof-johnsson/ncs/v3.4.0/zephyr/arch/arm64/Kconfig"
osource "/home/olof-johnsson/ncs/v3.4.0/zephyr/arch/arm/Kconfig"
osource "/home/olof-johnsson/ncs/v3.4.0/zephyr/arch/arc/Kconfig"
```

## stations/build/stations/Kconfig/boards/Kconfig
```kconfig
# Load Zephyr board Kconfig descriptions.
osource "/home/olof-johnsson/ncs/v3.4.0/zephyr/boards/others/promicro_nrf52840/Kconfig"
```

## stations/build_1/Kconfig/boards/Kconfig.sysbuild
```kconfig
# Load Sysbuild board Kconfig descriptions.
osource "/home/olof-johnsson/ncs/v3.4.0/zephyr/boards/nordic/nrf52840dk/Kconfig.sysbuild"
```

## stations/build_1/mcuboot/Kconfig/boards/Kconfig.defconfig.tmp
```kconfig
# Load Zephyr board defconfig descriptions.
osource "/home/olof-johnsson/ncs/v3.4.0/zephyr/boards/nordic/nrf52840dk/Kconfig.defconfig"
```

## stations/candy-dispenser/build/candy-dispenser/Kconfig/boards/Kconfig.tmp
```kconfig
# Load Zephyr board Kconfig descriptions.
osource "/home/olof-johnsson/ncs/v3.4.0/zephyr/boards/nordic/nrf7002dk/Kconfig"
```
